SECTIONS { . = 0x8007C13C; .text : { *(.text) } }
getintr = 0x8007AAB4;
D_8009B27C = 0x8009B27C;
D_8009B294 = 0x8009B294;
D_8009AFB8 = 0x8009AFB8;
D_8009AFB4 = 0x8009AFB4;
D_800A3468 = 0x800A3468;
D_800A3460 = 0x800A3460;
